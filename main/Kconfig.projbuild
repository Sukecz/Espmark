## main/Kconfig.projbuild
```kconfig
menu "espmark"

config ESPMARK_BOARD_NAME
    string "Board name reported in benchmark output"
    default "unknown-board"
    help
        Human-readable board name, for example "Seeed Studio XIAO ESP32C6".

config ESPMARK_BOARD_VENDOR
    string "Board vendor reported in benchmark output"
    default "unknown-vendor"

config ESPMARK_MODULE_NAME
    string "Module name reported in benchmark output"
    default "unknown-module"

config ESPMARK_RUN_LABEL
    string "Optional run label"
    default "local"

config ESPMARK_CPU_REPEAT
    int "CPU benchmark repetitions"
    default 20
    range 3 200

config ESPMARK_CPU_INNER_ITERATIONS
    int "CPU benchmark inner loop iterations"
    default 25000
    range 1000 10000000

endmenu
```

## sdkconfig.defaults
```kconfig
CONFIG_APP_REPRODUCIBLE_BUILD=y
CONFIG_COMPILER_OPTIMIZATION_PERF=y
CONFIG_ESP_DEFAULT_CPU_FREQ_MHZ=160
CONFIG_ESPMARK_BOARD_VENDOR="Seeed Studio"
CONFIG_ESPMARK_BOARD_NAME="XIAO ESP32C6"
CONFIG_ESPMARK_MODULE_NAME="ESP32-C6"
CONFIG_ESPMARK_RUN_LABEL="local-xiao-c6"
CONFIG_ESPMARK_CPU_REPEAT=20
CONFIG_ESPMARK_CPU_INNER_ITERATIONS=25000
```
